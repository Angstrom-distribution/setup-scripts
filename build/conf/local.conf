## build/conf/local.conf
```bitbake
# CONF_VERSION is increased each time build/conf/ changes incompatibly
CONF_VERSION = "1"

INHERIT += "rm_work"

# Which files do we want to parse:
BBMASK = ""

# Qemu 0.12.x is giving too much problems recently (2010.05), so disable it for users
ENABLE_BINARY_LOCALE_GENERATION = "0"

# What kind of images do we want?
IMAGE_FSTYPES += "tar.bz2"

# Make use of SMP:
#   PARALLEL_MAKE specifies how many concurrent compiler threads are spawned per bitbake process
#   BB_NUMBER_THREADS specifies how many concurrent bitbake tasks will be run
PARALLEL_MAKE     = "-j2"
BB_NUMBER_THREADS = "2"

DISTRO   = "angstrom-2010.x"

# Set terminal types by default it expects gnome-terminal
# but we chose xterm
TERMCMD = "${XTERM_TERMCMD}"
TERMCMDRUN = "${XTERM_TERMCMDRUN}"

# Don't generate the mirror tarball for SCM repos, the snapshot is enough
BB_GENERATE_MIRROR_TARBALLS = "0"
```

## conf/bblayers.conf
```bitbake
# LAYER_CONF_VERSION is increased each time build/conf/bblayers.conf
# changes incompatibly
LCONF_VERSION = "5"
TOPDIR := "${@os.path.dirname(os.path.dirname(d.getVar('FILE', True)))}"

BBPATH = "${TOPDIR}"

BBFILES = ""

# These layers hold recipe metadata not found in OE-core, but lack any machine or distro content
BASELAYERS ?= " \
  ${TOPDIR}/sources/meta-openembedded/meta-oe \
  ${TOPDIR}/sources/meta-openembedded/meta-efl \
  ${TOPDIR}/sources/meta-openembedded/meta-gpe \
  ${TOPDIR}/sources/meta-openembedded/meta-gnome \
  ${TOPDIR}/sources/meta-openembedded/meta-xfce \
  ${TOPDIR}/sources/meta-openembedded/meta-initramfs \
  ${TOPDIR}/sources/meta-openembedded/toolchain-layer \
  ${TOPDIR}/sources/meta-openembedded/meta-multimedia \
  ${TOPDIR}/sources/meta-openembedded/meta-networking \
  ${TOPDIR}/sources/meta-openembedded/meta-webserver \
  ${TOPDIR}/sources/meta-openembedded/meta-ruby \
  ${TOPDIR}/sources/meta-openembedded/meta-filesystems \
  ${TOPDIR}/sources/meta-openembedded/meta-perl \
  ${TOPDIR}/sources/meta-openembedded/meta-python \
  ${TOPDIR}/sources/meta-kde4 \
  ${TOPDIR}/sources/meta-java \
  ${TOPDIR}/sources/meta-browser \
  ${TOPDIR}/sources/meta-mono \
  ${TOPDIR}/sources/meta-qt5 \
  ${TOPDIR}/sources/meta-openembedded/meta-systemd \
  ${TOPDIR}/sources/meta-ros \
  ${TOPDIR}/sources/meta-uav \
  ${TOPDIR}/sources/meta-telephony \
  ${TOPDIR}/sources/meta-beagleboard/meta-beagleboard-extras \
"

# These layers hold machine specific content, aka Board Support Packages
BSPLAYERS ?= " \
  ${TOPDIR}/sources/meta-beagleboard/common-bsp \
  ${TOPDIR}/sources/meta-ti \
  ${TOPDIR}/sources/meta-fsl-arm \
  ${TOPDIR}/sources/meta-fsl-arm-extra \
  ${TOPDIR}/sources/meta-nslu2 \
  ${TOPDIR}/sources/meta-smartphone/meta-htc \
  ${TOPDIR}/sources/meta-smartphone/meta-nokia \
  ${TOPDIR}/sources/meta-smartphone/meta-openmoko \
  ${TOPDIR}/sources/meta-smartphone/meta-palm \
  ${TOPDIR}/sources/meta-handheld \
  ${TOPDIR}/sources/meta-intel \
  ${TOPDIR}/sources/meta-intel/meta-sugarbay \
  ${TOPDIR}/sources/meta-intel/meta-crownbay \
  ${TOPDIR}/sources/meta-intel/meta-emenlow \
  ${TOPDIR}/sources/meta-intel/meta-fri2 \
  ${TOPDIR}/sources/meta-intel/meta-jasperforest \
  ${TOPDIR}/sources/meta-sunxi \
  ${TOPDIR}/sources/meta-raspberrypi \
  ${TOPDIR}/sources/meta-minnow \
  ${TOPDIR}/sources/meta-dominion \
  ${TOPDIR}/sources/meta-atmel \
  ${TOPDIR}/sources/meta-exynos \
  ${TOPDIR}/sources/meta-gumstix-community \
"

# Add your overlay location to EXTRALAYERS
# Make sure to have a conf/layers.conf in there
EXTRALAYERS ?= " \
  ${TOPDIR}/sources/meta-linaro/meta-linaro \
  ${TOPDIR}/sources/meta-linaro/meta-linaro-toolchain \
  ${TOPDIR}/sources/meta-linaro/meta-aarch64 \
"

BBLAYERS = " \
  ${TOPDIR}/sources/meta-angstrom \
  ${BASELAYERS} \
  ${BSPLAYERS} \
  ${EXTRALAYERS} \
  ${TOPDIR}/sources/openembedded-core/meta \
  "
```

## conf/local.conf
```bitbake
# CONF_VERSION is increased each time build/conf/ changes incompatibly
CONF_VERSION = "1"

INHERIT += "rm_work"

# Which files do we want to parse:
BBMASK = "meta-ros/recipes-extended/wxwidgets"

# What kind of images do we want?
IMAGE_FSTYPES_append = " tar.xz"

# Make use of SMP:
#   PARALLEL_MAKE specifies how many concurrent compiler threads are spawned per bitbake process
#   BB_NUMBER_THREADS specifies how many concurrent bitbake tasks will be run
PARALLEL_MAKE     = "-j2"
BB_NUMBER_THREADS = "2"

DISTRO = "angstrom-v2013.06"
# Set DEPLOY_DIR outside of TMPDIR

DEPLOY_DIR = "${TMPDIR}/../../deploy/${TCLIBC}"
# Don't generate the mirror tarball for SCM repos, the snapshot is enough
BB_GENERATE_MIRROR_TARBALLS = "0"

# Disable build time patch resolution. This would lauch a devshell
# and wait for manual intervention. We disable it.
PATCHRESOLVE = "noop"

#
# Shared-state files from other locations
#
# Shared state files are prebuilt cache data objects which can 
# used to accelerate build time. This variable can be used to configure the system
# to search other mirror locations for these objects before it builds the data itself.
#
# This can be a filesystem directory, or a remote url such as http or ftp. These
# would contain the sstate-cache results from previous builds (possibly from other 
# machines). This variable works like fetcher MIRRORS/PREMIRRORS and points to the 
# cache locations to check for the shared objects.
#SSTATE_MIRRORS ?= "\
#file://.* http://someserver.tld/share/sstate/ \n \
#file://.* file:///some/local/dir/sstate/"

#SSTATE_MIRRORS ?= "\
#file://.* http://dominion.thruhere.net/angstrom/sstate-mirror/ \n "

# enable PR service on build machine itself
# its good for a case when this is the only builder
# generating the feeds
#
PRSERV_HOST = "localhost:0"
```
